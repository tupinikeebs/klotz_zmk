## config/boards/shields/klotz_esb/Kconfig.defconfig
```kconfig
if SHIELD_KLOTZ_ESB

config ZMK_KEYBOARD_NAME
    default "Klotz ESB"

config ZMK_SPLIT
    default y

config ZMK_SPLIT_ROLE_CENTRAL
    default y

config ZMK_SPLIT_BLE_CENTRAL_PERIPHERALS
    default 2

config BT_MAX_PAIRED
    default 2

endif

if SHIELD_KLOTZ_ESB_LEFT

config ZMK_KEYBOARD_NAME
    default "Klotz ESB L"

config ZMK_SPLIT
    default y

endif

if SHIELD_KLOTZ_ESB_RIGHT

config ZMK_KEYBOARD_NAME
    default "Klotz ESB R"

config ZMK_SPLIT
    default y

endif
```

## config/boards/shields/klotz_esb/Kconfig.shield
```kconfig
config SHIELD_KLOTZ_ESB
    def_bool $(shields_list_contains,klotz_esb)

config SHIELD_KLOTZ_ESB_LEFT
    def_bool $(shields_list_contains,klotz_esb_left)

config SHIELD_KLOTZ_ESB_RIGHT
    def_bool $(shields_list_contains,klotz_esb_right)
```

## config/west.yml
```yaml
manifest:
  remotes:
    - name: zmkfirmware
      url-base: https://github.com/zmkfirmware
    - name: nrfconnect
      url-base: https://github.com/nrfconnect
    - name: charlesmst
      url-base: https://github.com/charlesmst

  projects:
    - name: zmk
      remote: charlesmst
      revision: deskhop-sync-feature-report-v030
      import: app/west.yml

    - name: zmk-feature-split-esb
      remote: charlesmst
      revision: feature/key-state-bitmap

    - name: sdk-nrf
      remote: nrfconnect
      revision: v2.6.4
      path: nrf

    - name: nrfxlib
      remote: nrfconnect
      revision: v2.6.4
      repo-path: sdk-nrfxlib
      path: nrfxlib

  self:
    path: config
```
